## firmware/buildroot/apexsat_defconfig
```kconfig
# ═══════════════════════════════════════════════════════════════
# APEXSAT AI v1.0 - Buildroot Konfigürasyonu
# Hedef: Amlogic S905X4 (aarch64)
# ═══════════════════════════════════════════════════════════════

# ─── Mimari ──────────────────────────────────────────────────
BR2_aarch64=y
BR2_cortex_a55=y
BR2_ARM_FP_VFPV4=y
BR2_ARM_INSTRUCTIONS_THUMB2=y

# ─── Toolchain ──────────────────────────────────────────────
BR2_TOOLCHAIN_EXTERNAL=y
BR2_TOOLCHAIN_EXTERNAL_DOWNLOAD=y
BR2_TOOLCHAIN_EXTERNAL_ARM_AARCH64=y
# Alternatif: Linaro toolchain
# BR2_TOOLCHAIN_EXTERNAL_LINARO_AARCH64=y
BR2_TOOLCHAIN_EXTERNAL_CXX=y

# ─── Sistem Ayarları ────────────────────────────────────────
BR2_TARGET_GENERIC_HOSTNAME="apexsat"
BR2_TARGET_GENERIC_ISSUE="APEXSAT AI - Akilli DVB-S2 Uydu Alicisi"
BR2_TARGET_GENERIC_ROOT_PASSWD="apexsat2026"
BR2_SYSTEM_BIN_SH_BASH=y
BR2_INIT_SYSTEMD=y
BR2_ROOTFS_OVERLAY="$(BR2_EXTERNAL_APEXSAT_PATH)/rootfs_overlay"
BR2_ROOTFS_POST_BUILD_SCRIPT="$(BR2_EXTERNAL_APEXSAT_PATH)/post_build.sh"

# ─── Root Filesystem ────────────────────────────────────────
BR2_TARGET_ROOTFS_SQUASHFS=y
BR2_TARGET_ROOTFS_SQUASHFS4_XZ=y
BR2_TARGET_ROOTFS_EXT2=y
BR2_TARGET_ROOTFS_EXT2_4=y
BR2_TARGET_ROOTFS_EXT2_SIZE="512M"

# ─── Kernel ─────────────────────────────────────────────────
BR2_LINUX_KERNEL=y
BR2_LINUX_KERNEL_CUSTOM_TARBALL=y
BR2_LINUX_KERNEL_CUSTOM_TARBALL_LOCATION="https://cdn.kernel.org/pub/linux/kernel/v5.x/linux-5.15.150.tar.xz"
BR2_LINUX_KERNEL_USE_CUSTOM_CONFIG=y
BR2_LINUX_KERNEL_CUSTOM_CONFIG_FILE="$(BR2_EXTERNAL_APEXSAT_PATH)/kernel/apexsat_kernel_defconfig"
BR2_LINUX_KERNEL_DTS_SUPPORT=y
BR2_LINUX_KERNEL_CUSTOM_DTS_PATH="$(BR2_EXTERNAL_APEXSAT_PATH)/devicetree/apexsat-s905x4.dts"
BR2_LINUX_KERNEL_INSTALL_TARGET=y

# ─── Bootloader ─────────────────────────────────────────────
BR2_TARGET_UBOOT=y
BR2_TARGET_UBOOT_BUILD_SYSTEM_KCONFIG=y
BR2_TARGET_UBOOT_BOARDNAME="amlogic_s905x4"
BR2_TARGET_UBOOT_CUSTOM_VERSION=y
BR2_TARGET_UBOOT_CUSTOM_VERSION_VALUE="2023.10"

# ─── Donanım Paketleri ──────────────────────────────────────

# Firmware / blobs
BR2_PACKAGE_LINUX_FIRMWARE=y

# ─── DVB / Uydu ─────────────────────────────────────────────
BR2_PACKAGE_DVB_APPS=y
BR2_PACKAGE_DVBV5_UTILS=y
BR2_PACKAGE_W_SCAN=y
BR2_PACKAGE_W_SCAN2=y
BR2_PACKAGE_MUMUDVB=y

# ─── Medya Oynatma ──────────────────────────────────────────

# GStreamer
BR2_PACKAGE_GSTREAMER1=y
BR2_PACKAGE_GST1_PLUGINS_BASE=y
BR2_PACKAGE_GST1_PLUGINS_BASE_PLUGIN_ALSA=y
BR2_PACKAGE_GST1_PLUGINS_BASE_PLUGIN_AUDIOCONVERT=y
BR2_PACKAGE_GST1_PLUGINS_BASE_PLUGIN_AUDIORESAMPLE=y
BR2_PACKAGE_GST1_PLUGINS_BASE_PLUGIN_PLAYBACK=y
BR2_PACKAGE_GST1_PLUGINS_BASE_PLUGIN_VIDEOCONVERT=y
BR2_PACKAGE_GST1_PLUGINS_BASE_PLUGIN_VIDEOSCALE=y
BR2_PACKAGE_GST1_PLUGINS_BASE_PLUGIN_VOLUME=y
BR2_PACKAGE_GST1_PLUGINS_BASE_PLUGIN_TYPEFIND=y

BR2_PACKAGE_GST1_PLUGINS_GOOD=y
BR2_PACKAGE_GST1_PLUGINS_GOOD_PLUGIN_AUTODETECT=y
BR2_PACKAGE_GST1_PLUGINS_GOOD_PLUGIN_AVI=y
BR2_PACKAGE_GST1_PLUGINS_GOOD_PLUGIN_FLV=y
BR2_PACKAGE_GST1_PLUGINS_GOOD_PLUGIN_ISOMP4=y
BR2_PACKAGE_GST1_PLUGINS_GOOD_PLUGIN_MATROSKA=y
BR2_PACKAGE_GST1_PLUGINS_GOOD_PLUGIN_MPEGTS=y
BR2_PACKAGE_GST1_PLUGINS_GOOD_PLUGIN_PULSE=y
BR2_PACKAGE_GST1_PLUGINS_GOOD_PLUGIN_RTSP=y
BR2_PACKAGE_GST1_PLUGINS_GOOD_PLUGIN_RTP=y
BR2_PACKAGE_GST1_PLUGINS_GOOD_PLUGIN_UDP=y
BR2_PACKAGE_GST1_PLUGINS_GOOD_PLUGIN_V4L2=y

BR2_PACKAGE_GST1_PLUGINS_BAD=y
BR2_PACKAGE_GST1_PLUGINS_BAD_PLUGIN_MPEGTSDEMUX=y
BR2_PACKAGE_GST1_PLUGINS_BAD_PLUGIN_VIDEOPARSERS=y
BR2_PACKAGE_GST1_PLUGINS_BAD_PLUGIN_HLSDEMUX=y
BR2_PACKAGE_GST1_PLUGINS_BAD_PLUGIN_DASHDEMUX=y
BR2_PACKAGE_GST1_PLUGINS_BAD_PLUGIN_WEBRTC=y

BR2_PACKAGE_GST1_PLUGINS_UGLY=y
BR2_PACKAGE_GST1_PLUGINS_UGLY_PLUGIN_MPEG2DEC=y

BR2_PACKAGE_GST1_LIBAV=y

# FFmpeg
BR2_PACKAGE_FFMPEG=y
BR2_PACKAGE_FFMPEG_GPL=y
BR2_PACKAGE_FFMPEG_FFPLAY=y
BR2_PACKAGE_FFMPEG_FFPROBE=y
BR2_PACKAGE_FFMPEG_POSTPROC=y
BR2_PACKAGE_FFMPEG_SWSCALE=y
BR2_PACKAGE_FFMPEG_AVRESAMPLE=y

# ALSA
BR2_PACKAGE_ALSA_LIB=y
BR2_PACKAGE_ALSA_UTILS=y
BR2_PACKAGE_ALSA_UTILS_AMIXER=y
BR2_PACKAGE_ALSA_UTILS_APLAY=y

# PulseAudio
BR2_PACKAGE_PULSEAUDIO=y

# ─── Ağ ─────────────────────────────────────────────────────
BR2_PACKAGE_WPA_SUPPLICANT=y
BR2_PACKAGE_WPA_SUPPLICANT_AP_SUPPORT=y
BR2_PACKAGE_WPA_SUPPLICANT_WIFI_DISPLAY=y
BR2_PACKAGE_WPA_SUPPLICANT_WPS=y
BR2_PACKAGE_WPA_SUPPLICANT_WPA3=y

BR2_PACKAGE_IW=y
BR2_PACKAGE_WIRELESS_TOOLS=y
BR2_PACKAGE_DHCPCD=y
BR2_PACKAGE_IPTABLES=y

BR2_PACKAGE_SAMBA4=y
BR2_PACKAGE_NFS_UTILS=y

BR2_PACKAGE_MOSQUITTO=y
# MQTT client (APEXSENSE PRO entegrasyonu)

BR2_PACKAGE_CURL=y
BR2_PACKAGE_WGET=y

# ─── Bluetooth ──────────────────────────────────────────────
BR2_PACKAGE_BLUEZ5_UTILS=y
BR2_PACKAGE_BLUEZ5_UTILS_OBEX=y
BR2_PACKAGE_BLUEZ5_UTILS_PLUGINS_AUDIO=y

# ─── Grafik / Ekran ────────────────────────────────────────
BR2_PACKAGE_MESA3D=y
BR2_PACKAGE_MESA3D_GALLIUM_DRIVER_PANFROST=y
BR2_PACKAGE_MESA3D_OPENGL_EGL=y
BR2_PACKAGE_MESA3D_OPENGL_ES=y
BR2_PACKAGE_LIBDRM=y
BR2_PACKAGE_WAYLAND=y

# ─── Qt6 (UI Framework) ────────────────────────────────────
BR2_PACKAGE_QT6=y
BR2_PACKAGE_QT6BASE=y
BR2_PACKAGE_QT6BASE_GUI=y
BR2_PACKAGE_QT6BASE_WIDGETS=y
BR2_PACKAGE_QT6BASE_OPENGL=y
BR2_PACKAGE_QT6BASE_EGLFS=y
BR2_PACKAGE_QT6BASE_FONTCONFIG=y
BR2_PACKAGE_QT6BASE_HARFBUZZ=y
BR2_PACKAGE_QT6BASE_JPEG=y
BR2_PACKAGE_QT6BASE_PNG=y
BR2_PACKAGE_QT6BASE_SQLITE=y
BR2_PACKAGE_QT6BASE_TSLIB=y

BR2_PACKAGE_QT6DECLARATIVE=y
# QML desteği

BR2_PACKAGE_QT6MULTIMEDIA=y
# Medya oynatma entegrasyonu

BR2_PACKAGE_QT6SVG=y

# ─── Python (AI ve uygulama katmanı) ───────────────────────
BR2_PACKAGE_PYTHON3=y
BR2_PACKAGE_PYTHON3_PY_PYC=y
BR2_PACKAGE_PYTHON3_SQLITE=y
BR2_PACKAGE_PYTHON3_SSL=y
BR2_PACKAGE_PYTHON3_ZLIB=y

BR2_PACKAGE_PYTHON_NUMPY=y
BR2_PACKAGE_PYTHON_PAHO_MQTT=y

# ─── AI / ML ───────────────────────────────────────────────
# TensorFlow Lite (NPU inference)
# whisper.cpp (ses tanıma) - custom package olarak eklenecek
# piper-tts (ses sentezi) - custom package olarak eklenecek

# ─── Sistem Araçları ───────────────────────────────────────
BR2_PACKAGE_HTOP=y
BR2_PACKAGE_NANO=y
BR2_PACKAGE_SCREEN=y
BR2_PACKAGE_OPENSSH=y
BR2_PACKAGE_DROPBEAR=n
BR2_PACKAGE_UTIL_LINUX=y
BR2_PACKAGE_UTIL_LINUX_BINARIES=y
BR2_PACKAGE_E2FSPROGS=y
BR2_PACKAGE_DOSFSTOOLS=y
BR2_PACKAGE_NTFS_3G=y
BR2_PACKAGE_USBUTILS=y
BR2_PACKAGE_PCIUTILS=y
BR2_PACKAGE_I2C_TOOLS=y
BR2_PACKAGE_SPI_TOOLS=y

# ─── OTA Güncelleme ────────────────────────────────────────
BR2_PACKAGE_RAUC=y
# A/B partition scheme ile güvenli güncelleme

# ─── Hata Ayıklama (geliştirme, üretimde kaldırılacak) ────
BR2_PACKAGE_GDB=y
BR2_PACKAGE_STRACE=y
BR2_ENABLE_DEBUG=y
```

## firmware/buildroot/external/Config.in
```kconfig
source "$BR2_EXTERNAL_APEXSAT_PATH/package/whisper-cpp/Config.in"
source "$BR2_EXTERNAL_APEXSAT_PATH/package/piper-tts/Config.in"
source "$BR2_EXTERNAL_APEXSAT_PATH/package/apexsat-app/Config.in"
```

## firmware/buildroot/external/package/apexsat-app/Config.in
```kconfig
config BR2_PACKAGE_APEXSAT_APP
    bool "apexsat-app"
    depends on BR2_PACKAGE_PYTHON3
    depends on BR2_PACKAGE_QT6DECLARATIVE
    help
      APEXSAT AI ana uygulama paketi.
      DVB tarama, EPG, AI oneri, sesli asistan, UI.
```

## firmware/buildroot/external/package/piper-tts/Config.in
```kconfig
config BR2_PACKAGE_PIPER_TTS
    bool "piper-tts"
    depends on BR2_INSTALL_LIBSTDCPP
    help
      Piper - hizli, yerel TTS (Text-to-Speech) motoru.
      Turkce ses sentezi icin kullanilir.
      https://github.com/rhasspy/piper
```

## firmware/buildroot/external/package/whisper-cpp/Config.in
```kconfig
config BR2_PACKAGE_WHISPER_CPP
    bool "whisper-cpp"
    depends on BR2_INSTALL_LIBSTDCPP
    help
      OpenAI Whisper ses tanima modeli C/C++ implementasyonu.
      APEXSAT AI sesli asistan icin kullanilir.
      https://github.com/ggerganov/whisper.cpp
```

## firmware/buildroot/kernel/apexsat_kernel_defconfig
```kconfig
# APEXSAT AI - Linux Kernel Config (S905X4)
# Base: arm64 defconfig + DVB + V4L2

# Architecture
CONFIG_ARCH_MESON=y

# DVB subsystem
CONFIG_MEDIA_SUPPORT=y
CONFIG_MEDIA_DIGITAL_TV_SUPPORT=y
CONFIG_DVB_CORE=y
CONFIG_DVB_DEMUX_SECTION_LOSS_LOG=y

# DVB Frontend drivers
CONFIG_DVB_STV0910=m
CONFIG_DVB_CX24116=m
CONFIG_DVB_SI2166=m
CONFIG_DVB_STV6111=m
CONFIG_DVB_LNBH25=m

# DVB Tuner drivers
CONFIG_MEDIA_TUNER=y
CONFIG_MEDIA_TUNER_SI2157=m
CONFIG_MEDIA_TUNER_R820T=m

# V4L2 (Video4Linux2) - HW decode
CONFIG_VIDEO_V4L2=y
CONFIG_VIDEO_DEV=y

# Amlogic VDEC
CONFIG_VIDEO_MESON_VDEC=y

# USB DVB adapters (PoC asamasi icin)
CONFIG_DVB_USB=m
CONFIG_DVB_USB_V2=m
CONFIG_DVB_USB_TBS5580=m
CONFIG_DVB_USB_DVBSKY=m

# Filesystem
CONFIG_EXT4_FS=y
CONFIG_SQUASHFS=y
CONFIG_SQUASHFS_XZ=y
CONFIG_NTFS_FS=m
CONFIG_VFAT_FS=y
CONFIG_EXFAT_FS=m
CONFIG_FUSE_FS=y

# USB
CONFIG_USB_SUPPORT=y
CONFIG_USB_XHCI_HCD=y
CONFIG_USB_EHCI_HCD=y
CONFIG_USB_STORAGE=y
CONFIG_USB_UAS=y

# Network
CONFIG_NET=y
CONFIG_INET=y
CONFIG_IPV6=y
CONFIG_NETFILTER=y
CONFIG_CFG80211=m
CONFIG_MAC80211=m

# Bluetooth
CONFIG_BT=m
CONFIG_BT_HCIBTUSB=m
CONFIG_BT_HCIUART=m
CONFIG_BT_RFCOMM=m

# Sound
CONFIG_SOUND=y
CONFIG_SND=y
CONFIG_SND_SOC=y
CONFIG_SND_SOC_MESON_AXG_SOUND_CARD=y

# GPIO / I2C / SPI
CONFIG_GPIOLIB=y
CONFIG_I2C=y
CONFIG_I2C_MESON=y
CONFIG_SPI=y
CONFIG_SPI_MESON_SPICC=y

# PWM (fan kontrolu)
CONFIG_PWM=y
CONFIG_PWM_MESON=y

# HDMI
CONFIG_DRM=y
CONFIG_DRM_MESON=y
CONFIG_DRM_MESON_DW_HDMI=y

# IR remote
CONFIG_IR_MESON=y
CONFIG_RC_CORE=y
CONFIG_RC_DECODERS=y
CONFIG_IR_NEC_DECODER=y
CONFIG_IR_RC5_DECODER=y

# Thermal
CONFIG_THERMAL=y
CONFIG_CPU_THERMAL=y
CONFIG_AMLOGIC_THERMAL=y

# Watchdog
CONFIG_WATCHDOG=y
CONFIG_MESON_GXBB_WATCHDOG=y

# RTC
CONFIG_RTC_CLASS=y
```
